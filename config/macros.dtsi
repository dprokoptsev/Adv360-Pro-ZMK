macro_braces: macro_braces{
compatible = "zmk,behavior-macro";
label = "macro_braces";
wait-ms = <10>;
#binding-cells = <0>;
bindings = <&kp LBRC>, <&kp RBRC>, <&kp LEFT>, <&kp ENTER>, <&kp ENTER>, <&kp UP>, <&kp TAB>;
};
